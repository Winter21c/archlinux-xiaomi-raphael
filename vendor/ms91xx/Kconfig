## vendor/ms91xx/Kconfig
```kconfig
# SPDX-License-Identifier: GPL-2.0
config DRM_MS91XX
	tristate "MacroSilicon MS91xx USB display driver"
	depends on DRM && USB
	select DRM_KMS_HELPER
	select DRM_GEM_SHMEM_HELPER
	select DRM_TTM
	select DRM_TTM_HELPER
	help
	  Say Y here if you want support for MacroSilicon MS9132/MS9133/MS9135
	  USB display chips. Based on official MacroSilicon GPL-2.0 source,
	  fixed to build on modern kernels (6.8+).

	  This driver supports both VID:PID 345f:9132/9133/9135, and
	  534d:6021 (which mode-switches to the same functional identity).

	  If M is selected the module will be called usbdisp_drm.
```
